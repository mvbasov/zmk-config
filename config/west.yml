## config/west.yml
```yaml
manifest:
  remotes:
    - name: zmkfirmware
      url-base: https://github.com/petejohanson
    - name: gpeye
      url-base: https://github.com/GPeye
    - name: mvbasov
      url-base: https://github.com/mvbasov
  projects:
    - name: zmk
      remote: zmkfirmware
      revision: feat/pointers-move-scroll
      import: app/west.yml
    - name: urchin-peripheral-animation
      remote: gpeye
      revision: main
    - name: nice-view-sun
      remote: mvbasov
      revision: main
  self:
    path: config
```
